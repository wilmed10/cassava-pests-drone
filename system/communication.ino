#define _DEBUG_
#include <ESP8266WiFi.h>
#include <WiFiClient.h>
#include <ESP8266WebServer.h>
#include <SPI.h>
#include <Wire.h>
#include <avr/pgmspace.h>
#include <Adafruit_GFX.h>
#include <Adafruit_SSD1306.h>

const char *ssid = "drone";
const char *password = "mico1234";

// Define the pins for the push buttons
const int btnCamara = 0;
const int btnDeteccion = 02;
const int btnGuardar = 14;
const int btnApagar = 12;

String response = "nada";
int estado=0;

ESP8266WebServer server(81);

// Definir constantes
#define ANCHO_PANTALLA 128 // wide OLED screen
#define ALTO_PANTALLA 64 // high OLED screen

// Objeto de la clase Adafruit_SSD1306
Adafruit_SSD1306 display(ANCHO_PANTALLA, ALTO_PANTALLA, &Wire, -1);

//Imagenes
#define DRON_WIDTH 120
#define DRON_HEIGHT 90
const unsigned char PROGMEM DRON[] = {
0x00, 0x00, 0x00, 0x00, 0x00, 0x00, 0x00, 0x00, 0x00, 0x00, 0x00, 0x00, 0x00, 0x00, 0x00, 0x00, 
0x00, 0x00, 0x00, 0x00, 0x00, 0x00, 0x00, 0x00, 0x00, 0x00, 0x00, 0x00, 0x00, 0x00, 0x00, 0x00, 
0x00, 0x00, 0x00, 0x00, 0x00, 0x00, 0x00, 0x00, 0x00, 0x00, 0x00, 0x00, 0x00, 0x00, 0x00, 0x00, 
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0x00, 0x00, 0x00, 0x00, 0x00, 0x00
};

#define CAMARA_WIDTH 86
#define CAMARA_HEIGHT 52
const unsigned char PROGMEM CAMARA[] = {
0x00, 0x00, 0x00, 0x00, 0x00, 0x00, 0x00, 0x00, 0x00, 0x00, 0x00, 0x00, 0x00, 0x00, 0x00, 0x00, 
0x00, 0x00, 0x00, 0x00, 0x00, 0x00, 0x00, 0x00, 0x00, 0x00, 0x00, 0x00, 0x00, 0x00, 0x00, 0x00, 
0x00, 0x00, 0x00, 0x00, 0x00, 0x00, 0x00, 0x00, 0x00, 0x00, 0x00, 0x00, 0x00, 0x00, 0x00, 0x00, 
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0x00, 0x00, 0x00, 0x00, 0x00, 0x00, 0x00, 0x00, 0x00, 0x00, 0x00, 0x00
};

#define LUPA_WIDTH 86
#define LUPA_HEIGHT 52
const unsigned char PROGMEM LUPA[] = {
0x00, 0x00, 0x00, 0x00, 0x00, 0x00, 0x00, 0x00, 0x00, 0x00, 0x00, 0x00, 0x00, 0x00, 0x00, 0x00, 
0x00, 0x00, 0x00, 0x00, 0x00, 0x00, 0x00, 0x00, 0x00, 0x00, 0x00, 0x00, 0x00, 0x00, 0x00, 0x00, 
0x00, 0x00, 0x00, 0x00, 0x00, 0x00, 0x00, 0x00, 0x00, 0x00, 0x00, 0x00, 0x00, 0x00, 0x00, 0x00, 
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0x00, 0x00, 0x00, 0x00, 0x00, 0x00, 0x00, 0x00, 0x00, 0x00, 0x00, 0x00
};

#define USB_WIDTH 40
#define USB_HEIGHT 50
const unsigned char PROGMEM USB[]={
0x00, 0x00, 0x00, 0x00, 0x00, 0x00, 0x00, 0x00, 0x00, 0x00, 0x00, 0x00, 0x00, 0x00, 0x00, 0x00, 
0x00, 0x00, 0x00, 0x00, 0x00, 0x00, 0x00, 0x00, 0x00, 0x00, 0x00, 0x00, 0x1f, 0x00, 0x00, 0x00, 
0x00, 0x3f, 0x80, 0x00, 0x00, 0x00, 0x7f, 0x80, 0x00, 0x00, 0x00, 0xf3, 0xe0, 0x00, 0x00, 0x01, 
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0x00, 0x00, 0x00, 0x00, 0x00, 0x00, 0x00, 0x00, 0x00, 0x00
};

#define APAGAR_WIDTH 50
#define APAGAR_HEIGHT 40
const unsigned char PROGMEM APAGAR[] = {
0x00, 0x00, 0x01, 0xe0, 0x00, 0x00, 0x00, 0x00, 0x00, 0x03, 0xf0, 0x00, 0x00, 0x00, 0x00, 0x00, 
0x03, 0xf0, 0x00, 0x00, 0x00, 0x00, 0x00, 0x03, 0xf0, 0x00, 0x00, 0x00, 0x00, 0x00, 0x03, 0xf0, 
0x00, 0x00, 0x00, 0x00, 0x00, 0x03, 0xf0, 0x00, 0x00, 0x00, 0x00, 0x03, 0xc3, 0xf0, 0xf0, 0x00, 
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0x00, 0x00, 0x00, 0x1f, 0xfe, 0x00, 0x00, 0x00
};

void setup() {
  Serial.begin(115200);
  WiFi.softAP(ssid, password);

  IPAddress IP = WiFi.softAPIP();
  Serial.print("Dirección IP del AP: ");
  Serial.println(IP);

  // Configure the push button pins as inputs with pull-up resistor
  pinMode(btnCamara, INPUT_PULLUP);
  pinMode(btnDeteccion, INPUT_PULLUP);
  pinMode(btnGuardar, INPUT_PULLUP);
  pinMode(btnApagar, INPUT_PULLUP);

    // Start OLED display at address 0x3C
  if (!display.begin(SSD1306_SWITCHCAPVCC, 0x3C)) {
#ifdef _DEBUG_
    Serial.println("No se encuentra la pantalla OLED");
#endif
    while (true);
  }

  display.clearDisplay();
  display.setTextSize(1);
  display.setTextColor(WHITE);
  display.setCursor(0,0);
  display.println("   Deteccion Dron");
  display.display();

  display.drawLine(0, 10, 128, 10, WHITE);
  display.display();
  display.drawBitmap( (display.width() - DRON_WIDTH) /4, ((display.height() - DRON_HEIGHT) /4) , DRON, DRON_WIDTH, DRON_HEIGHT, WHITE);
  display.display();
  delay(1000);

  server.on("/", handleRoot);
  server.begin();
}

void Menu() {
  display.clearDisplay();
  display.setTextSize(1);
  display.setTextColor(WHITE);
  display.setCursor(0,0);
  display.println("        MODOS");
  display.display();

  display.setTextSize(1);
  display.setTextColor(WHITE);
  display.setCursor(0,20);
  display.println(" 1. Video             2. Iniciar deteccion 3. Guardar deteccion 4. Apagar RPI");
  display.display();
  delay(1000);
}

void loop() {
  server.handleClient();
  bool botonPresionado = false;
  
  while (estado==0){
    sendCommandToRaspberryPi("gps");
    if(response == "nada"){
      display.clearDisplay();
      display.setTextSize(1);
      display.setTextColor(WHITE);
      display.setCursor(0,30);
      display.println("Esperando coordenadas");
      display.display();
      delay(2000);
    }else { 
      estado=1;
    }
  }

  do {
    Menu();
   // Read the status of the buttons
    if (!digitalRead(btnCamara) || !digitalRead(btnDeteccion) || !digitalRead(btnGuardar) || !digitalRead(btnApagar)) {
      botonPresionado = true;
    }else {
      sendCommandToRaspberryPi("dime");
    }
 
  } while (!botonPresionado);

  if (!digitalRead(btnCamara)) {
    display.clearDisplay();
    display.setTextSize(1);
    display.setTextColor(WHITE);
    display.setCursor(0,0);
    display.println("        Video");
    display.display();
    display.drawBitmap( (display.width() - CAMARA_WIDTH) /2 , ((display.height() - CAMARA_HEIGHT) /2)+7, CAMARA, CAMARA_WIDTH, CAMARA_HEIGHT, WHITE);
    display.display();
    Serial.println("boton1");
    delay(500);
    sendCommandToRaspberryPi("button1");    
  } else if (!digitalRead(btnDeteccion)) {
    display.clearDisplay();
    display.setTextSize(1);
    display.setTextColor(WHITE);
    display.setCursor(0,0);
    display.println("  Iniciar Deteccion");
    display.display();
    display.drawBitmap( (display.width() - LUPA_WIDTH) /2, ((display.height() - LUPA_HEIGHT) /2)+7, LUPA, LUPA_WIDTH, LUPA_HEIGHT, WHITE);
    display.display();
    Serial.println("boton2");
    delay(500);
    sendCommandToRaspberryPi("button2");
  } else if (!digitalRead(btnGuardar)) {
    display.clearDisplay();
    display.setTextSize(1);
    display.setTextColor(WHITE);
    display.setCursor(0,0);
    display.println("  Guardar deteccion");
    display.display();
    display.drawBitmap( (display.width() - USB_WIDTH)-5, ((display.height() - USB_HEIGHT) ), USB, USB_WIDTH, USB_HEIGHT, WHITE);
    display.display();
    display.setTextSize(1);
    display.setTextColor(WHITE);
    display.setCursor(0,50);
    display.println("Almacenando");
    display.display();
    Serial.println("boton3");
    delay(500);
    sendCommandToRaspberryPi("button3");
  } else if (!digitalRead(btnApagar)) {
    display.clearDisplay();
    display.setTextSize(1);
    display.setTextColor(WHITE);
    display.setCursor(0,0);
    display.println("      Apagar RPI");
    display.display();
    display.drawBitmap( (display.width() - APAGAR_WIDTH)/2, ((display.height() - APAGAR_HEIGHT)/2 )+9, APAGAR, APAGAR_WIDTH, APAGAR_HEIGHT, WHITE);
    display.display();
    Serial.print("boton4");
    delay(500);
    sendCommandToRaspberryPi("button4");
  }
}

void handleRoot() {
  server.send(200, "text/plain", "¡Hola! Has llegado al ESP8266.");
}

void sendCommandToRaspberryPi(String command) {
  WiFiClient client;
    if (client.connect("192.168.4.200", 8081)) { // Raspberry Pi IP address on ESP8266 network
      client.print(command);
      // Wait for a response from the Raspberry Pi
      while (client.connected() || client.available()) {
        if (client.available()) {
          response = client.readStringUntil('\n'); // Read the answer
          // Display the answer on the OLED screen
          
          if (response != "nada") {
            display.clearDisplay();
            display.setTextSize(1);
            display.setTextColor(WHITE);
            display.setCursor(5,30);
            display.println(response);
            display.display();
            delay(3000);
            Serial.println("Respuesta de Raspberry Pi: " + response); // Display on serial console
          }

        }
      }
      client.stop();
    }
}